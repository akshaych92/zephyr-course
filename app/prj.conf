## CMakeLists.txt
```
cmake_minimum_required(VERSION 3.20.0)

list(APPEND BOARD_ROOT ${CMAKE_CURRENT_SOURCE_DIR})
list(APPEND DTS_ROOT ${CMAKE_CURRENT_SOURCE_DIR})
find_package(Zephyr REQUIRED)
project(my_zephyr_app)

target_sources(app PRIVATE src/main.cpp)

add_subdirectory(driver/our_driver)
```

## Kconfig
```
# source "Kconfig.zephyr"
config APP_HEARTBEAT_PERIOD_MS
    int "Heartbeat period (ms)"
    default 500
    range 100 2000

menuconfig LED_SUBSYSTEM
    bool "LED Subsystem"

    help
      Enable LED subsystem support.

if LED_SUBSYSTEM
    choice 
        prompt "LED Blink sleep"
        default BLINK_SLEEP_1000MS
    
    config BLINK_SLEEP_1000MS
        bool "Medium (1s)"
    
    config BLINK_SLEEP_250MS
        bool "Very Fast (250ms)"
    
    config BLINK_SLEEP_2000MS
        bool "Slow (2s)"
    
    config BLINK_SLEEP_500MS
        bool "Fast (500ms)"
    
    endchoice

    config BLINK_SLEEP_TIME_MS
        int
        default 1000 if BLINK_SLEEP_1000MS
        default 250 if BLINK_SLEEP_250MS
        default 2000 if BLINK_SLEEP_2000MS
        default 0
    
menuconfig ADVANCED_LED_SETTINGS
    bool "Advanced LED Settings"

if ADVANCED_LED_SETTINGS    
    config LED_BRIGHTNESS
            int "LED Brightness (0-100)"
            default 50
            range 0 100
        
    config LED_FADE
            int "LED Fade Duration (ms)"
            default 500
            range 0 5000

menu "Expert Settings"
    visible if ADVANCED_LED_SETTINGS

    config LED_DEBUG
        bool "Enable LED Debugging"

    config CUSTOM_BLINK_PATTERN
        bool "Custom Blink Pattern"

endmenu

endif
    
endif

source "Kconfig.zephyr"
rsource "driver/our_driver/Kconfig"
```

## prj.conf
```kconfig
CONFIG_GPIO=y
CONFIG_SENSOR=y
CONFIG_LOG=y
CONFIG_LOG_MODE_IMMEDIATE=y
CONFIG_OUR_DRIVER=y
CONFIG_SHELL=y
CONFIG_SHELL_PROMPT_UART="my-shell> "
CONFIG_LOG_CMDS=y
```

## app.overlay
```dts
/ {
  //  aliases{
   //     app-led = &green_led_4;
  //  };

    my_sensor: our_sensor {
        compatible = "our,driver";
        gpios = <&gpio4 17 GPIO_ACTIVE_LOW>;
        status = "okay";
    };
};
```

## dts/bindings/our,driver.yaml
```yaml
description: Our custom sensor driver

compatible: "our,driver"
include: base.yaml
properties:
  gpios:
    type: phandle-array
    required: true
```

## src/main.cpp
```c
#include <zephyr/kernel.h>
#include <zephyr/logging/log.h>
#include <zephyr/drivers/sensor.h>

extern "C" {
#include "our_driver.h"
}

#define SLEEP_TIME_MS 1000

/* The devicetree node identifier for the "led0" alias. */
// #define LED_NODE DT_ALIAS(app_led)

// static const struct gpio_dt_spec led = GPIO_DT_SPEC_GET(LED_NODE, gpios);

const struct device *led = DEVICE_DT_GET(DT_NODELABEL(my_sensor));

LOG_MODULE_REGISTER(main, LOG_LEVEL_ERR);

int main(void)
{
    if(!device_is_ready(led)) {
        LOG_ERR("LED device is not ready");
        return 0;
    }

    struct sensor_value value;

    while (1)
    {
        // sensor_sample_fetch(led);
        // LOG_INF("LED set using the fetch API");
        k_msleep(CONFIG_APP_HEARTBEAT_PERIOD_MS);
        // sensor_channel_get(led, SENSOR_CHAN_ALL, &value);
        // LOG_INF("LED reset using the channel get API");
        // k_msleep(CONFIG_APP_HEARTBEAT_PERIOD_MS);

        // LOG_INF("Toggle count: %d", our_driver_get_toggle_count(led));

        // /* Reset the toggle count every 10 toggles using the custom extension API */
        // if (our_driver_get_toggle_count(led) >= 10) {
        //     our_driver_reset_toggle_count(led);
        // }
    }
    return 0;
}
```
